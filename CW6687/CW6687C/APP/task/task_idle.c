/*****************************************************************************
 * Module    : Task
 * File      : task_idle.c
 * Author    : Hanny
 * Function  : 空闲任务
 *****************************************************************************/
#include "include.h"
#include "task.h"
#include "api_device.h"

#if DAC_EN
#pragma data_alignment=2
IAR_XDATA_A u8 spi_pcm_buf[288] @ "SPI_BUF";

#pragma data_alignment=32
IAR_CONST u8 period[576] = {
	0x00, 0x00, 0x00, 0x00, 0xCC, 0x02, 0x34, 0xFD, 0x97, 0x05, 0x69, 0xFA, 0x60, 0x08, 0xA1, 0xF7,
	0x24, 0x0B, 0xDC, 0xF4, 0xE2, 0x0D, 0x1E, 0xF2, 0x9B, 0x10, 0x66, 0xEF, 0x4A, 0x13, 0xB7, 0xEC,
	0xF1, 0x15, 0x0F, 0xEA, 0x8C, 0x18, 0x74, 0xE7, 0x1C, 0x1B, 0xE4, 0xE4, 0x9F, 0x1D, 0x62, 0xE2,
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	0xDC, 0xF4, 0x23, 0x0B, 0xA0, 0xF7, 0x5F, 0x08, 0x69, 0xFA, 0x97, 0x05, 0x34, 0xFD, 0xCC, 0x02
};
#endif

//task_idle controller
#pragma location="TASK_IDLE_SEG"
void task_idle_display(void);

//任务初始化
#pragma location="TASK_IDLE_SEG"
void task_idle_enter(void)
{
    led_mode_off();
    led_idle();
}

//任务退出
#pragma location="TASK_IDLE_SEG"
void task_idle_exit(void)
{
#if MODE_CHANGE_BLUE_ON
    led_mode_on();
#endif
}

//任务事件
#pragma location="TASK_IDLE_SEG"
void task_idle_event(void)
{
#if DAC_EN
#if 1
    u16 i;
    //printf("%02x\n", spi_get_status());
    if ((spi_get_status() & 0xff) & BIT(0)) {
        spi_get_pcm(spi_pcm_buf);
        //printf_array(spi_pcm_buf, 288);
        //printf("ok\n");
        for (i=0; i<288; i+=4) {
            while(!(AUCON7 & BIT(7)));
            AUCON5 = spi_pcm_buf[i+1];
            AUCON5 = spi_pcm_buf[i];
            while(!(AUCON7 & BIT(7)));
            AUCON5 = spi_pcm_buf[i+3];
            AUCON5 = spi_pcm_buf[i+2];
        }
    }
#else
    u16 i;
    for (i=0; i<576; ) {
        while(!(AUCON7 & BIT(7)));
        AUCON5 = period[i+1];
        AUCON5 = period[i];
        i+=2;
        while(!(AUCON7 & BIT(7)));
        AUCON5 = period[i+1];
        AUCON5 = period[i];
        i+=2;
    }
#endif
#endif
    WATCHDOG_CLR();
    if (device_need_activate(DEVICE_PC)) {
        if (device_activate(DEVICE_PC)) {
            task_ctl.work_sta = TASK_USBDEV;
        }
    }
}

//任务主流程
#pragma location="TASK_IDLE_SEG"
void task_idle(void)
{
    //printf("task_idle\n");
    task_idle_enter();
    while (task_ctl.work_sta == TASK_IDLE) {
        task_idle_event();
    }
    task_idle_exit();
}

