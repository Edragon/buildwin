/*****************************************************************************
 * Module    : XCL
 * File      : APP_LLP.xcl
 * Author    : Hanny
 * Function  : 用户XCL空间分配。
 *****************************************************************************/
//BANK
-D_BANK_LEN=0x800
-D_BANK_START=0x1800
-D_BANK_STEP=0x10000
-D_BANK_NUM=0x40

-D_BANK_0_START=0x001800
-D_BANK_1_START=0x011800
-D_BANK_2_START=0x021800
-D_BANK_3_START=0x031800
-D_BANK_4_START=0x041800

-D_BANK_20_START=0x201800
-D_BANK_21_START=0x211800
-D_BANK_22_START=0x221800
-D_BANK_23_START=0x231800
-D_BANK_24_START=0x241800
-D_BANK_25_START=0x251800
-D_BANK_26_START=0x261800
-D_BANK_27_START=0x271800
-D_BANK_28_START=0x281800
-D_BANK_29_START=0x291800
-D_BANK_2A_START=0x2A1800
-D_BANK_2B_START=0x2B1800
-D_BANK_2C_START=0x2C1800
-D_BANK_2D_START=0x2D1800
-D_BANK_2E_START=0x2E1800
-D_BANK_2F_START=0x2F1800
-D_BANK_30_START=0x301800
-D_BANK_31_START=0x311800
-D_BANK_32_START=0x321800
-D_BANK_33_START=0x331800
-D_BANK_34_START=0x341800
-D_BANK_35_START=0x351800
-D_BANK_36_START=0x361800
-D_BANK_37_START=0x371800
-D_BANK_38_START=0x381800
-D_BANK_39_START=0x391800
-D_BANK_3A_START=0x3A1800
-D_BANK_3B_START=0x3B1800
-D_BANK_3C_START=0x3C1800
-D_BANK_42_START=0x421800

//MINIBANK
-D_MINIBANK_LEN=0x100
-D_MINIBANK_START=0x803F00
-D_MINIBANK_STEP=0x10000
-D_MINIBANK_NUM=0x30

-D_MINIBANK_0_START=0x803F00
-D_MINIBANK_1_START=0x813F00
-D_MINIBANK_2_START=0x823F00
-D_MINIBANK_3_START=0x833F00
-D_MINIBANK_4_START=0x843F00
-D_MINIBANK_5_START=0x843F00

/*****************************************************************************
 * Section   : 以下是控制的Bank分段，比较关注切Bank的效率及位置
 *****************************************************************************/

//测试段
-Z(CODE)TEST_BANK1=_BANK_1_START:+_BANK_LEN
-Z(CODE)TEST_BANK2=_BANK_2_START:+_BANK_LEN
-Z(CODE)TEST_BANK3=_BANK_3_START:+_BANK_LEN
-Z(CODE)TEST_BANK4=_BANK_4_START:+_BANK_LEN

-Z(CODE)TEST_MINIBANK0=_MINIBANK_0_START:+_MINIBANK_LEN
-Z(CODE)TEST_MINIBANK1=_MINIBANK_1_START:+_MINIBANK_LEN
-Z(CODE)TEST_MINIBANK2=_MINIBANK_2_START:+_MINIBANK_LEN
-Z(CODE)TEST_MINIBANK3=_MINIBANK_3_START:+_MINIBANK_LEN
-Z(CODE)TEST_MINIBANK4=_MINIBANK_4_START:+_MINIBANK_LEN

//初始化段
-Z(CODE)CSTART,INIT_SEG,INIT_CONST=_BANK_0_START:+_BANK_LEN

//文字显示功能控制
-Z(CODE)RES_SEG,DRAW_TEXT_SEG,FONT_SEG,HP_INIT_SEG,HP_INIT_CONST=0x11800-0x11FFF

//显示功能控制
-Z(CODE)RES_IMG_SEG,DISP_SEG,DISP_TASK_SEG,DISP_LED_SEG=0x21800-0x21FFF
-Z(CODE)DRAW_IMG_SEG=0x101800-0x101FFF

//文件系统扫描
-Z(CODE)FS_SCAN_SEG,FS_SCAN_SEG_CONST,FILE_FILTER_SEG,FILE_FILTER_CONST=0x31800-0x31FFF

-Z(CODE)CHECK_BOX_SEG,CHECK_CONTENT=0x41800-0x41FFF

-Z(CODE)BT_RXAT_CMD2,BT_RXAT_CMD2_CONST=0x61800-0x61FFF

//动态列表框
-Z(CODE)LIST_BOX_A_SEG,LIST_A_CONTENT,RESAMPLE_INIT,RESAMPLE_INIT_CONST=0x61800-0x61FFF

//文件列表框
-Z(CODE)FILE_LIST_SEG,FILE_LIST_CONST,FNAV_SEG=0x71800-0x71FFF
-Z(CODE)FAT_API_SEG_2=0x71800-0x71FFF

//进度框
-Z(CODE)PROGRESS_SEG,PROGRESS_CONTENT=0x81800-0x81FFF

//用户设置
-Z(CODE)TASK_AUX_SEG,TASK_AUX_CONST=0x91800-0x91FFF
-Z(CODE)USER_SETTING_SEG,USER_SETTING_CONST=0x111800-0x111FFF
-Z(CODE)BT_AVCTP_RX,BT_AVCTP_RX_CONST=0xA1800-0xA1FFF

//LED数据码屏显示功能
-Z(CODE)DISP_LEDSEG_TBL,DISP_LEDSEG_SEG,DISP_LEDSEG_CONST,LEDSEG_OCX,DISP_LED_5C7S_SEG,DISP_LED_7P7S_SEG=0xB1800-0xB1FFF

//LCD显示功能
-Z(CODE)TASK_SHOW_TIME_SEG,TASK_USBDEV_LCD,TASK_FM_DISP,TASK_LRC_DISP=0xB1800-0xB1FFF

//BT显示功能
-Z(CODE)BT_DISP,BT_DISP_PARAM=_BANK_42_START:+_BANK_LEN
-Z(CODE)TASK_BT_RING_SEG,TASK_BT_RING_CONST,BT_MENU_DISP,BT_MENU_DISP_PARAM=0x3B1800-0x3B1FFF

//用户对话框
-Z(CODE)DEVICE_SEG,DEVICE_SEG_CONST=0xC1800-0xC1FFF

-Z(CODE)BT_RFC,BT_RFC_CONST=0xD1800-0xD1FFF

-Z(CODE)SPI_WRITE_SEG,SPI_WRITE_SEG_CONST,TASK_UPDATE_SEG,TASK_UPDATE_SEG_CONST=0xE1800-0xE1FFF

//长文件名匹配
-Z(CODE)FAT_LFN_SEG=0xE1800-0xE1FFF
-Z(CODE)MUSIC_ID3_SEG,DISP_SEG_1=0xE1800-0xE1FFF

//歌词显示功能
-Z(CODE)LRC_SEG,LRC_ASM=0xF1800-0xF1FFF

//字符串
-Z(CODE)LOAD_STRING_SEG,STRING_SEG=0x101800-0x101FFF
-Z(CODE)LOAD_STRING_SEG_2,STRING_SEG_2=0x111800-0x111FFF

-Z(CODE)FAT_API_SEG,FAT_API_CONST=0x131800-0x131FFF
-Z(CODE)FS_INIT_SEG,FS_INIT_CONST=0x141800-0x141FFF
-Z(CODE)MUSIC_SEG,FS_INIT_SEG_2=0x151800-0x151FFF
-Z(CODE)TASK_FM_INIT,TASK_FM_INIT_CONST,FM_INIT,FM_INIT_RDA5807,FM_INIT_CONST_RDA5807,FM_INIT_QN8035,FM_SEG_RTC6218_1,FM_INIT_CONST_BK1080,FM_INIT_BK1080,FM_INIT_CONST_AX5111,FM_INIT_AX5111=0x161800-0x161FFF
-Z(CODE)DAC_INIT,DAC_INIT_CONST=0x171800-0x171FFF

//任务分段
-Z(CODE)TASK_MENU_SEG,TASK_MENU_CONST=0x181800-0x181FFF
-Z(CODE)TASK_SETTING_SEG,TASK_SETTING_CONST=0x191800-0x191FFF
-Z(CODE)TASK_RECORD_SEG,TASK_RECORD_CONST=0x1A1800-0x1A1FFF
-Z(CODE)FAT_WRITE_API,TASK_RECORD_WRITE_SEG=0x1A1800-0x1A1FFF
-Z(CODE)TASK_USBDEV_SEG,TASK_USBDEV_SEG_CONST,USB_DEV_SEG,USB_DEV_MASS_SEG,USB_DEV_AUDIO_SEG,USB_HID_SEG,SD_STOP_SEG=0x1B1800-0x1B1FFF
-Z(CODE)SPP_RX_SEG,SPP_RX_CONST,SPP_TX_SEG=0x301800-0x301FFF

-Z(CODE)TASK_FM_SEG_CONST,TASK_FM_SEG,FM_SEG,FM_IIC_SEG,FM_SEG_RDA5807,FM_SEG_BK1080,FM_SEG_QN8035,FM_INIT_RTC6218,FM_CONST_RTC6218,FM_SEG_RTC6218,FM_SEG_QN8065_CONST,FM_SEG_QN8065,FM_CONST_AX5111,FM_SEG_AX5111,FM_CONST_RTC6207,FM_SEG_RTC6207,DRAW_FREQ_SEG,DRAW_FREQ_CONST,MUSIC_FREQ_SEG=0x1D1800-0x1D1FFF
-Z(CODE)FAT_API_WRITE_SEG=0x1E1800-0x1E1FFF
-Z(CODE)FAT_API_WRITE_SEG_2=0x1F1800-0x1F1FFF

-Z(CODE)BT_MAIN_MSG,BT_MAIN_MSG_CONST,BT_INIT_SEG,BT_INIT_CONST,BT_RESET8202,BT_RESET8202_CONST=0x1F1800-0x1F1FFF

-Z(CODE)TIME_SEG,SET_TIME_SEG,SET_TIME_CONST=0x201800-0x201FFF
-Z(CODE)TASK_MUSIC_SEG,TASK_MUSIC_SEG_CONST=0x211800-0x211FFF
-Z(CODE)TASK_MUSIC_MENU_SEG_1,TASK_MUSIC_SEG_2=0x121800-0x121FFF

-Z(CODE)TASK_CLOCK_SEG,TASK_CLOCK_SEG_CONST,TASK_CLOCK_CONST=0x221800-0x221FFF

-Z(CODE)BT_CRC_SEG,BT_CRC_CONST,BT_A2DP_MMI,USB_HOSTHID_SEG=0x241800-0x241FFF
-Z(CODE)TASK_SPEAKER_SEG,TASK_SPEAKER_CONST,SDADC_SEG,SDADC_SEG_CONST,TASK_AUX_EQ_SEG,TASK_AUX_EQ_SEG_CONST=0x231800-0x231FFF

-Z(CODE)BT_SDP_RXEXT=0x251800-0x251FFF

//-Z(CODE)TASK_TOMCAT_SEG=0x261800-0x261FFF
-Z(CODE)BT_RXAT_CMD,BT_RXAT_CMD_CONST=0x261800-0x261FFF

-Z(CODE)TASK_MUSIC_SEG_1=0x3D1800-0x3D1FFF

//-Z(CODE)LUNAR_ALGORITHM,LUNAR_ALGORITHM_CONST=0x291800-0x291FFF
-Z(CODE)BT_RFC_TX,BT_RFC_TX_CONST=0x291800-0x291FFF


//-Z(CODE)CHECK_BOX_SEG,CHECK_CONTENT=0x2A1800-0x2A1FFF
-Z(CODE)HCI_SEND_ACL,BT_AVCTP=0x2A1800-0x2A1FFF

//-Z(CODE)TASK_BT_SEG,TASK_BT_SEG_CONST,MSG_BT_SEG,MSG_BT_CONST,TASK_BT_RING_SEG,TASK_BT_RING_CONST,TASK_BT_CALL_SEG,TASK_BT_CALL_CONST,TASK_BT_TEST_SEG=0x271800-0x271FFF
-Z(CODE)TASK_BT_SEG,MSG_BT_SEG,MSG_BT_CONST,TASK_BT_CALL_SEG,TASK_BT_CALL_CONST,TASK_BT_TEST_SEG=0x271800-0x271FFF
-Z(CODE)TASK_BT_LOST_SEG,TASK_BT_HID_SEG,TASK_BT_HID_CONST=0x281800-0x281FFF
-Z(CODE)BT_API=0x2D1800-0x2D1FFF   //Note:BT_API_PARAM,BT_API_PARAM_NR两个段必须放在同一bank
-Z(CODE)BT_API_CMD,BT_API_CONST=0x2E1800-0x2E1FFF
-Z(CODE)BT_API2,BT_API_PARAM,BT_API_PARAM_NR=0x2F1800-0x2F1FFF
-Z(CODE)BT_PBAP_SEG,BT_PBAP_CONST_SEG=0x3E1800-0x3E1FFF
-Z(CODE)BT_PBAP_API,BT_PBAP_API_CONST=0x3F1800-0x3F1FFF
-Z(CODE)BT_PBAP_PARSE,BT_PBAP_PARSE_CONST=0x401800-0x401FFF
-Z(CODE)BT_PBAP_BANK_SEG=0x411800-0x411FFF

//静态列表框

-Z(CODE)TASK_SEG,TASK_CONST=_BANK_20_START:+_BANK_LEN
-Z(CODE)TASK_HOLD_SEG,TASK_HOLD_N_SEG=_BANK_20_START:+_BANK_LEN
-Z(CODE)BT_DEBUG_SEG,BT_DEBUG_CONST=0x2F1800-0x2F1FFF
-Z(CODE)LIST_BOX_SEG,LIST_CONTENT=_BANK_30_START:+_BANK_LEN
-Z(CODE)BT_SHOWINFO_SEG,BT_SHOWINFO_CONST=_BANK_31_START:+_BANK_LEN
-Z(CODE)BT_AVDTP_SIGNAL,BT_AVDTP_SIGNAL_CONST=_BANK_31_START:+_BANK_LEN
-Z(CODE)TASK_MUSIC_MENU_SEG,TASK_MIC_SEG,TASK_MIC_CONST=_BANK_32_START:+_BANK_LEN
-Z(CODE)TASK_RECORD_SEG_1,TASK_RECORD_1_CONST=_BANK_33_START:+_BANK_LEN
-Z(CODE)BT_LINK_KEY_SEG,BT_LINK_KEY_CONST=_BANK_34_START:+_BANK_LEN
-Z(CODE)USB_HOST_EXT,TASK_ALARM_SEG,TASK_ALARM_SEG_CONST=_BANK_35_START:+_BANK_LEN
-Z(CODE)TASK_POWER,TASK_IDLE_SEG,SYS_SEG,RTC_SEG,RTC_SEG_CONST,POWER_CTL_SEG=_BANK_36_START:+_BANK_LEN
-Z(CODE)FS_SCAN_SEG_2=_BANK_37_START:+_BANK_LEN
-Z(CODE)TASK_TOMCAT_SEG,TASK_TOMCAT_INIT,TASK_TOMCAT_CONST,SPI_WRITE_API=_BANK_38_START:+_BANK_LEN
-Z(CODE)TASK_FMREC_SEG,TASK_FMREC_CONST=_BANK_39_START:+_BANK_LEN
-Z(CODE)MUSIC_ID3_SEG_1,MUSIC_ID3_TBL=_BANK_3A_START:+_BANK_LEN
-Z(CODE)MUSIC_ID3_SEG_2,MUSIC_ID3_TBL2=_BANK_3C_START:+_BANK_LEN

/*****************************************************************************
 * Section   : Bank区随意分段
 *****************************************************************************/

-P(CODE)FAT_SEG,FAT_API_SEG_1,MP3_SEG_1,\
DEV_INIT,USB_INIT,SD_INIT,GET_FILENAME=[_BANK_START:+_BANK_LEN]*_BANK_NUM+_BANK_STEP

//Note: 一般不知道放哪里的，就放在这里
-P(CODE)LCD_INIT_SEG,FONT_SEG1,FILE_LIST_SEG_1,FILE_FILTER_SEG_1,FM_SEG_QN8065_1,FM_SEG_AX5111_1,\
TASK_MENU_SEG_1,TASK_FM_SEG_1,TASK_UPDATE_SEG_1,FAT_API,\
MSG_BOX_SEG,NUM_BOX_SEG,ALARM,DISPLAY_MEM,PASSWORD_SEG,INIT_SEG_1,TASK_CLOCK_SEG_1,TASK_EBOOK_SEG1,TASK_BT_SEG_1,BT_API_1,\
TASK_EBOOK_SEG2,DRAW_IMG_SEG1,FNAV_SEG_1,TASK_REPEATER_SEG_1,TASK_REPEATER_SEG_2,LRC_INIT,LRC_API,LIST_BOX_SEG1,TASK_SETTING_SEG_1,\
BT_CONN_CHK_SEG,WAV_INIT,TEMPO_INIT,TASK_MUSIC_SEG_3\
=[_BANK_START:+_BANK_LEN]*_BANK_NUM+_BANK_STEP

-P(CODE)BT_HCI,BT_HCI_ACL,BT_HCI_EVENT_DISC,BT_HCI_EVENT_DISC_1,BT_HCI_EVENT_LINK,BT_HCI_EVENT_CONN,BT_HCI_EVENT_CMD=[_BANK_START:+_BANK_LEN]*_BANK_NUM+_BANK_STEP

-P(CODE)BT_L2CAP,BT_L2CAP_CREATE,BT_L2CAP_SIG=[_BANK_START:+_BANK_LEN]*_BANK_NUM+_BANK_STEP

-P(CODE)BT_L2CAP_SIG_CONN,BT_L2CAP_CONN_IND,BT_L2CAP_CONN_CFM,BT_L2CAP_DISC_IND=[_BANK_START:+_BANK_LEN]*_BANK_NUM+_BANK_STEP

-P(CODE)BT_L2CAP_HDL,BT_SDP_CFM,BT_L2CA_CONNRSP,BT_L2CAP_CONNRSP,BT_L2CAP_DEL,BT_L2CAP_FREE=[_BANK_START:+_BANK_LEN]*_BANK_NUM+_BANK_STEP

-P(CODE)BT_L2CAP_CFGREQ,BT_L2CA_CFGRSP,BT_L2CAP_CFGRSP,BT_L2CAP_CFGRES=[_BANK_START:+_BANK_LEN]*_BANK_NUM+_BANK_STEP
-P(CODE)BT_L2CAP_LCID,BT_L2CAP_DISCREQ,BT_L2CAP_DISCRES,BT_L2CAP_ECHO,BT_L2CAP_INFO=[_BANK_START:+_BANK_LEN]*_BANK_NUM+_BANK_STEP
-P(CODE)BT_L2CAP_PROC=[_BANK_START:+_BANK_LEN]*_BANK_NUM+_BANK_STEP

-P(CODE)BT_API_SEG=[_BANK_START:+_BANK_LEN]*_BANK_NUM+_BANK_STEP
-P(CODE)BT_SDP_CONN=[_BANK_START:+_BANK_LEN]*_BANK_NUM+_BANK_STEP
-P(CODE)BT_HID_CONN,BT_HID=[_BANK_START:+_BANK_LEN]*_BANK_NUM+_BANK_STEP
-P(CODE)BT_SDP_DISCREQ=[_BANK_START:+_BANK_LEN]*_BANK_NUM+_BANK_STEP
-P(CODE)BT_SDP_SERRSP=[_BANK_START:+_BANK_LEN]*_BANK_NUM+_BANK_STEP
-P(CODE)BT_SDP_ERRRSP,BT_SDP_ATTR=[_BANK_START:+_BANK_LEN]*_BANK_NUM+_BANK_STEP
-P(CODE)BT_SDP_CHK,BT_SDP_CHK_1=[_BANK_START:+_BANK_LEN]*_BANK_NUM+_BANK_STEP
-P(CODE)BT_SDP_SHOW=[_BANK_START:+_BANK_LEN]*_BANK_NUM+_BANK_STEP
-P(CODE)BT_SDP_SERREQ,BT_SDP_SERAREQ=[_BANK_START:+_BANK_LEN]*_BANK_NUM+_BANK_STEP
-P(CODE)BT_RFC_SERCH=[_BANK_START:+_BANK_LEN]*_BANK_NUM+_BANK_STEP

-P(CODE)BT_HSHF,BT_HSHF_API=[_BANK_START:+_BANK_LEN]*_BANK_NUM+_BANK_STEP

-P(CODE)BT_AVDTP,BT_AVDTP_NG=[_BANK_START:+_BANK_LEN]*_BANK_NUM+_BANK_STEP

-P(CODE)BT_RFC_STATE,BT_RFC_MCC,BT_RFC_SABM,BT_RFC_UA,BT_RFC_RXDM,BT_RFC_PDISC,BT_RFC_RXDISC,BT_RFC_UIH=[_BANK_START:+_BANK_LEN]*_BANK_NUM+_BANK_STEP
-P(CODE)BT_RFC_CREDIT,BT_RFC_CFM=[_BANK_START:+_BANK_LEN]*_BANK_NUM+_BANK_STEP

-P(CODE)BT_RFC_SEND,BT_RFC_SEND_CREDIT=[_BANK_START:+_BANK_LEN]*_BANK_NUM+_BANK_STEP
-P(CODE)BT_RFC_CONN,BT_RFC_SEG=[_BANK_START:+_BANK_LEN]*_BANK_NUM+_BANK_STEP
-P(CODE)BT_AP_DISC,BT_AVDTP_MEDIA_CONN,BT_AVCTP_CONN,BT_AVDTP_CONN=[_BANK_START:+_BANK_LEN]*_BANK_NUM+_BANK_STEP

-P(CODE)BT_ON_SEG,BT_ON_CONST,RF_SEG=[_BANK_START:+_BANK_LEN]*_BANK_NUM+_BANK_STEP
-P(CODE)BT_A2DP_CONN,BT_RFC_SEND_2=[_BANK_START:+_BANK_LEN]*_BANK_NUM+_BANK_STEP
-P(CODE)BANKED_CODE,BT_AVDTP_MEDIA1=[_BANK_START:+_BANK_LEN]*_BANK_NUM+_BANK_STEP

/*****************************************************************************
 * Section   : 以下是控制的MiniBank分段，比较关注切Bank的效率及位置
 *****************************************************************************/
-Z(CODE)MSG_COMM_SEG,MSG_COMM_CONST=_MINIBANK_0_START:+_MINIBANK_LEN
-Z(CODE)MUSIC_API,MUSIC_API_CONST=_MINIBANK_1_START:+_MINIBANK_LEN
-Z(CODE)LRC_FILTER_SEG,LRC_FILTER_CONST=_MINIBANK_2_START:+_MINIBANK_LEN
-Z(CODE)TASK_BT_MINI_SEG,TASK_BT_MINI_SEG_CONST=_MINIBANK_3_START:+_MINIBANK_LEN

/*****************************************************************************
 * Section   : MiniBank区随意分段
 *****************************************************************************/
-P(CODE)SYS_API=[_MINIBANK_START:+_MINIBANK_LEN]*_MINIBANK_NUM+_MINIBANK_STEP
-P(CODE)BUCK_API=[_MINIBANK_START:+_MINIBANK_LEN]*_MINIBANK_NUM+_MINIBANK_STEP
-P(CODE)MUSIC_API_1,MUSIC_API_2=[_MINIBANK_START:+_MINIBANK_LEN]*_MINIBANK_NUM+_MINIBANK_STEP
-P(CODE)BT_HCI_API=[_MINIBANK_START:+_MINIBANK_LEN]*_MINIBANK_NUM+_MINIBANK_STEP
-P(CODE)DAC_API,DAC_API2,DAC_API3,DAC_API4=[_MINIBANK_START:+_MINIBANK_LEN]*_MINIBANK_NUM+_MINIBANK_STEP
-P(CODE)FAT_API_MINI=[_MINIBANK_START:+_MINIBANK_LEN]*_MINIBANK_NUM+_MINIBANK_STEP
-P(CODE)MP3_API,MP3_API_2=[_MINIBANK_START:+_MINIBANK_LEN]*_MINIBANK_NUM+_MINIBANK_STEP
//-P(CODE)LRC_FILTER_SEG=[_MINIBANK_START:+_MINIBANK_LEN]*_MINIBANK_NUM+_MINIBANK_STEP
-P(CODE)MINI_FILTER_SEG_1=[_MINIBANK_START:+_MINIBANK_LEN]*_MINIBANK_NUM+_MINIBANK_STEP
-P(CODE)MINI_FILTER_SEG_2=[_MINIBANK_START:+_MINIBANK_LEN]*_MINIBANK_NUM+_MINIBANK_STEP
-P(CODE)MINI_FILTER_SEG_3=[_MINIBANK_START:+_MINIBANK_LEN]*_MINIBANK_NUM+_MINIBANK_STEP
-P(CODE)MOUNT_SEG=[_MINIBANK_START:+_MINIBANK_LEN]*_MINIBANK_NUM+_MINIBANK_STEP
-P(CODE)POWER_CHECK_SEG=[_MINIBANK_START:+_MINIBANK_LEN]*_MINIBANK_NUM+_MINIBANK_STEP

/*****************************************************************************
 * Section   : 公共区空间的分段
 *****************************************************************************/
-Z(CODE)BT_UART_TX_SEG,USB_AUDIO_GET_PCM,L2CADATA_READ=_CODE_START-_CODE_END
-Z(CODE)DISP_LEDSEG_SCAN=_CODE_START-_CODE_END

/*****************************************************************************
 * Section   : 任务局部公共区空间
 *****************************************************************************/
-Z(CODE)FAT_COM_SEG,MP3_DEC_COM,MUSIC_COM,WMA_DEC_COM=_CODE_START-_CODE_END
-Z(CODE)BT_MODE_API,PHONE_CALL_NUM,BT_UART_ROUTE=_CODE_START-_CODE_END

/*****************************************************************************
 * Section   : DCODE空间的分段，请勿随意添加
 *****************************************************************************/
//6K供FM模块使用
-Z(CODE)TASK_FMPLAY_SEG,TASK_FMPLAY_DISP_SEG=0xFA4000-0xFA57FF

//6K供蓝牙模块使用
-Z(CODE)BT_SCO_SEG,USB_SCO_RESAMPLE_ASM,SCO_PCM_OUT=0xF54800-0xF55FFF
-Z(CODE)BT_DEC_SEG=0xF54800-0xF55FFF

-Z(CODE)BT_DEC_INT_SEG,SBC_PCM_OUT,BT_AVDTP_MEDIA,BT_VOICE_SEG,BT_STATE_CHANGE=0xF54800-0xF55FFF
-Z(CODE)HCI_EVENT_DSEG,HCI_SEND_CMD_DSEG,HCI_TXCMD_HOSTNUM=0xF54800-0xF55FFF
-Z(CODE)USB_RESAMPLE_ASM,BT_RESAMPLE_CONST=0xF54800-0xF55FFF
-Z(CODE)AEC_INIT,AEC_SEG,AEC_TBL=0xF54800-0xF55FFF

//2k供WAV模块使用
-Z(CODE)ADPCM_TBL,ADPCM_COM=0xF75800-0xF759FF
-Z(CODE)WAV_DEC_COM,WAV_DEC_SEG,ADPCM_DEC,WAV_HOOK,PCM_ASM=0xF75A00-0xF75FFF
-Z(CODE)ADPCM_ENC=0xF85A00-0xF85FFF

//1k供SPEAKER和AUX_EQ使用
-Z(CODE)DAC_OUT=0xFB4000-0xFB40FF
-Z(CODE)MIX_PROC=0xFB4100-0xFB43FF
-Z(CODE)AUX_PROC=0xFC4100-0xFC43FF

//2K供TOMCAT使用
-Z(CODE)TOMCAT_PROC,TEMPO_INPUT,TEMPO_OUTPUT=0xFD5800-0xFD5FFF
-Z(CODE)TEMPO_GET_POS,TEMPO_HAN_WIN,TEMPO_RESAMPLE,TEMPO_DAC_OUT=0xFD5800-0xFD5FFF

//982Byte供MP3压缩使用
-Z(CODE)MP3_EN_COM=0xFE0E00-0xFE11D5

//临时区
-Z(CODE)SEARCH_AVDTP=0xF54800-0xF55FFF

-Z(CODE)MAKECODE_CONST=0xFF0000-0xFF00FF
-Z(CODE)MAKEBAT_CONST=0xFF0100-0xFF03FF

/*****************************************************************************
 * Section   : 以内存空间的分段
 *****************************************************************************/

-Z(XDATA)EXT_XDATA=0x2218-0x22E3
-Z(XDATA)DIR_PATH_XDATA,DIR_PATH_CACHE,DIR_DPATH_CTL=0x8000-0x8fff
-Z(XDATA)FLIST_BUF,FLIST_XDATA,FNAV_XDATA=0x28090-293FF
-Z(XDATA)FILE_PATH_BUF=0x0E00-0x0F54
-Z(XDATA)ADC_BUF=0x20800-0x20DFF
-Z(XDATA)BTEQ_BUF=0x30800-0x30DFF

-Z(XDATA)BtPaired#0x0100

-Z(XDATA)WAV_EN_HEADER_BUF=0x18000-0x183FF
-Z(XDATA)WAV_ENCODE_BUF=0x4000-0x57FF

-Z(XDATA)EBOOK_BUF,LOG_BUF=0x38000
//-Z(XDATA)OCX_XDATA=_IXDATA_START-_IXDATA_END
-Z(XDATA)OCX_XDATA=0x002c-0x0099


-Z(XDATA)FM_XDATA=0x3CB0-0x3CFF
-Z(XDATA)MP3EN_XDATA#0x3CFF
-Z(XDATA)EBOOK_XDATA=0x13CB0-0x13CFF
-Z(XDATA)RECORD_XDATA=0x23CB0-0x23CFF
-Z(XDATA)SPEAKER_XDATA,UPDATE_XDATA=0x33CB0-0x33CFF
-Z(XDATA)SYS_XDATA=0x43CB0-0x43CFF
-Z(XDATA)CLOCK_XDATA=0x53CB0-0x53CFF
-Z(XDATA)HOLD_XDATA,BT_XDATA=0x63CB0-0x63CFF
-Z(XDATA)AUX_EQ_XDATA=0x73CB0-0x73CFF
-Z(XDATA)MUSIC_XDATA=0x83CB0-0x83CFF
-Z(XDATA)TOMCAT_XDATA=0x93CB0-0x93CFF
//-Z(XDATA)MUSIC_ID3BUFF=0x59800
-Z(XDATA)MUSIC_ID3BUFF=0x60800

-Z(XDATA)FM_CH_BUF=0x38000
-Z(XDATA)FM_WAV_HEADER_BUF=0x48000-0x483FF
-Z(XDATA)FM_WAV_ENCODE_BUF=0x14000-0x157FF

//BT decode's xdata and data
-Z(DATA)USB_RESAMPLE_DATA=0x149-0x151

-Z(XDATA)BT_SDBuf=0x69000:+0x200
-Z(XDATA)BT_SBC_XDATA=0x88900:+0xC00
-Z(XDATA)BT_AVDTP_XDATA=0x8F400:+0x800
-Z(XDATA)BT_SCOFAR_XDATA=0x9F400:+0x800
//-Z(XDATA)BT_PBAP_BUF=0xBF400:+0x800

-Z(XDATA)AEC_FFT_XDATA=0x94000:+0x400
-Z(XDATA)AEC_XDATA,NR_XDATA,AEC_OUT_BUF=0xC000:+0x3000
-Z(XDATA)BT_PBAP_BUF=0xA8900:+0xC00

-Z(XDATA)SD_SAVE_BUF=0x99500

-Z(XDATA)WAV_XDATA=0x5159A

//SPK buffer
-Z(XDATA)ECHO_BUF=0xA4400:+0x2000

-Z(XDATA)TEMPO_XDATA=0x9362-0x938C
-Z(XDATA)TOMCAT_WBUF=0x48000-0x483FF
-Z(XDATA)TOMCAT_ADC_BUF=0x44000-0x45BFF
-Z(XDATA)TOMCAT_RBUF=0x40800-0x40AF9
-Z(XDATA)TEMPO_HAN_BUF=0x40FD0-0x41210

-Z(XDATA)LCD_BUFF1=0x50800-0x50BFF      // lcd大buf
-Z(XDATA)LCD_BUFF2=0x40C00-0x40CFF      // lcd小buf
-Z(XDATA)LCD_BUFF3=0x30FD0-0x310CF      // lcd小buf，复用DEC_BUF
-Z(XDATA)LCD_BUFF4=0x69800-0x698ff      // lcd小buf,用于AUX录音和FM录音时的显示
-Z(XDATA)DIR2_XDATA,DIR2_PATH_XDATA,DIR2_LFN,DIR2_WIN=0x30B00

//0xFF    //OTP最后10Byte保
-Z(CODE)PROGRAM_CODE=0x7FF0-0x7FFF

-Z(XDATA)ID3_BUFF#0x100FF
