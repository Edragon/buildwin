/*****************************************************************************
 * Module    : XCL
 * File      : APP_LLP.xcl
 * Author    : Hanny
 * Email     : coldney@yahoo.com.cn
 * Function  : 用户XCL空间分配。
 *****************************************************************************/
-D_BANK_START=0x11800
-D_BANK_END=0x11FFF
-D_BANK_STEP=0x10000
-D_BANK_NUM=0x3D

/*****************************************************************************
 * Section   : 以下是控制的Bank分段，比较关注切Bank的效率及位置
 *****************************************************************************/

//初始化段
-Z(CODE)CSTART,INIT_SEG,INIT_CONST=0x1800-0x1FFF

//文字显示功能控制
-Z(CODE)RES_SEG,DRAW_TEXT_SEG,FONT_SEG,HP_INIT_SEG,HP_INIT_CONST=0x11800-0x11FFF

//显示功能控制
-Z(CODE)RES_IMG_SEG,DISP_SEG,DRAW_IMG_SEG,DISP_TASK_SEG,DISP_LED_SEG=0x21800-0x21FFF

//文件系统扫描
-Z(CODE)FS_SCAN_SEG,FS_SCAN_SEG_CONST,FILE_FILTER_SEG,FILE_FILTER_CONST=0x31800-0x31FFF


//-Z(CODE)BT_UART_TX_SEG,BT_UART_TX_ASM=0x41800-0x41FFF
-Z(CODE)BT_MAIN_API,BT_L2CAP_API,BT_A2DP_API,BT_HSF_API,BT_SCO_API,BT_SCO_TABLE,BT_MAIN_CONST=0x51800-0x51FFF
-Z(CODE)HCI_EVENT_SEG=0x51800-0x51FFF
-Z(CODE)BT_AVDTP_SIG_API,BT_AVDTP_MEDIA_API,BT_AVCTP_API=0x51800-0x51FFF
-Z(CODE)BT_SDP_API,BT_RFCOMM_API,BT_RFC_API,BT_HANDFREE_API,BT_HID_API=0x51800-0x51FFF
-Z(CODE)BT_L2CAP_RX,HOSTNUM_COMPLETED=0x51800-0x51FFF
-Z(CODE)TASK_BTEVENT_SEG=0x51800-0x51FFF
-Z(CODE)BT_PATCH_SEG,BT_PATCH_CONST=0x61800-0x61FFF
-Z(CODE)TASK_VOICE_SEG,TASK_VOICE_CONST=0x71800-0x71FFF

//静态列表框
-Z(CODE)LIST_BOX_SEG,LIST_CONTENT=0x61800-0x61FFF

//动态列表框
-Z(CODE)LIST_BOX_A_SEG,LIST_A_CONTENT,RESAMPLE_INIT,RESAMPLE_INIT_CONST=0x61800-0x61FFF

//文件列表框
-Z(CODE)FILE_LIST_SEG,FILE_LIST_CONST,FNAV_SEG=0x71800-0x71FFF

//进度框
-Z(CODE)PROGRESS_SEG,PROGRESS_CONTENT=0x81800-0x81FFF

//用户设置
-Z(CODE)USER_SETTING_SEG,USER_SETTING_CONST=0x91800-0x91FFF

//歌词显示功能
-Z(CODE)LRC_SEG,LRC_ASM=0xA1800-0xA1FFF

//LED数据码屏显示功能
-Z(CODE)DISP_LEDSEG_TBL,DISP_LEDSEG_SEG,DISP_LEDSEG_CONST,LEDSEG_OCX,DISP_LED_5C7S_SEG,DISP_LED_7P7S_SEG=0x21800-0x21FFF

//用户对话框
-Z(CODE)USER_MSG_SEG,USER_MSG_CONST,FAT_API_SEG,FAT_API_CONST,FAT_LOAD_SEG=0xC1800-0xC1FFF

-Z(CODE)SPI_WRITE_SEG,SPI_WRITE_API,SPI_WRITE_SEG_CONST,TASK_UPDATE_SEG=0xD1800-0xD1FFF

//长文件名匹配
-Z(CODE)FAT_LFN_SEG=0xE1800-0xE1FFF

-Z(CODE)USB_HOST_EXT=0xD1800-0xD1FFF
-Z(CODE)MUSIC_ID3_SEG,MUSIC_ID3_TBL=0x3C1800-0x3C1FFF
-Z(CODE)ID3_SEG,ID3_CONST=0x3D1800-0x3D1FFF

//字符串
-Z(CODE)LOAD_STRING_SEG,STRING_SEG=0x101800-0x101FFF
-Z(CODE)LOAD_STRING_SEG_2,STRING_SEG_2=0x111800-0x111FFF

-Z(CODE)MP3_EN_SEG,MP3_EN_SEG_CONST=0x131800-0x131FFF
-Z(CODE)DEVICE_SEG,DEVICE_SEG_CONST,FS_INIT_SEG,FS_INIT_CONST=0x141800-0x141FFF
-Z(CODE)MUSIC_SEG,MUSIC_SEG_CONST=0x151800-0x151FFF
-Z(CODE)TASK_FM_INIT,TASK_FM_INIT_CONST,FM_INIT,FM_INIT_CONST,FM_INIT_RDA5807,FM_INIT_CONST_RDA5807,FM_INIT_QN8035,FM_INIT_CONST_BK1080,FM_INIT_BK1080,FM_INIT_CONST_AX5111,FM_INIT_AX5111,FM_INIT_RTC6218,FM_INIT_RTC6207=0x161800-0x161FFF
-Z(CODE)TASK_TAPE_INIT,TASK_TAPE_INIT_CONST=0x171800-0x171FFF

//任务分段
-Z(CODE)TASK_MENU_SEG,TASK_MENU_CONST=0x181800-0x181FFF
-Z(CODE)TASK_SETTING_SEG,TASK_SETTING_CONST=0x191800-0x191FFF
-Z(CODE)TASK_AUX_SEG,TASK_AUX_CONST,TASK_MIC_SEG,TASK_MIC_CONST=0x1A1800-0x1A1FFF
-Z(CODE)MP3_EN_WRITE_SEG,FAT_API_WRITE_SEG,TASK_FMREC_SEG,TASK_FM_RECORD_DISP,TASK_RECORD_SEG,TASK_RECORD_CONST=0x41800-0x41FFF
-Z(CODE)TASK_USBDEV_SEG,TASK_USBDEV_SEG_CONST,USB_DEV_SEG,USB_DEV_MASS_SEG,USB_DEV_AUDIO_SEG,USB_HID_SEG,SD_STOP_SEG=0x1B1800-0x1B1FFF
-Z(CODE)TASK_EBOOK_SEG,TASK_EBOOK_CONST,SPP_RX_SEG,SPP_RX_CONST=0x1C1800-0x1C1FFF

-Z(CODE)TASK_FM_SEG_CONST,TASK_FM_SEG,TASK_FM_CONST,TASK_FM_DISP,FM_SEG,FM_IIC_SEG,FM_SEG_RDA5807,FM_SEG_BK1080,FM_SEG_QN8035,FM_SEG_QN8065_CONST,FM_SEG_QN8065,FM_CONST_AX5111,FM_SEG_AX5111,FM_CONST_RTC6218,FM_SEG_RTC6218,FM_CONST_RTC6207,FM_SEG_RTC6207,DRAW_FREQ_SEG,DRAW_FREQ_CONST,MUSIC_FREQ_SEG=0x1D1800-0x1D1FFF
//-Z(CODE)TASK_TAPE_SEG,TASK_TAPE_CONST=0x1F1800-0x1F1FFF

-Z(CODE)BT_MAIN_MSG,BT_MAIN_MSG_CONST,BT_INIT_SEG,BT_INIT_CONST,BT_RESET8202,BT_RESET8202_CONST=0x1F1800-0x1F1FFF

-Z(CODE)TASK_ALARM_SEG,TASK_ALARM_CONST,TIME_SEG,TIME_CONST,SET_TIME_SEG,SET_TIME_CONST=0x201800-0x201FFF
-Z(CODE)TASK_MUSIC_SEG,TASK_MUSIC_SEG_CONST=0x211800-0x211FFF

//-Z(CODE)TASK_CLOCK_SEG,TASK_CLOCK_CONST=0x221800-0x221FFF
-Z(CODE)BT_CRC_SEG,BT_CRC_CONST,BT_A2DP_MMI,USB_HOSTHID_SEG=0x221800-0x221FFF

-Z(CODE)TASK_POWER,TASK_IDLE_SEG=0x231800-0x231FFF
-Z(CODE)TASK_REPEATER_SEG=0x241800-0x241FFF
-Z(CODE)TASK_SPEAKER_SEG,TASK_SPEAKER_CONST,TASK_AUX_EQ_SEG=0x231800-0x231FFF

-Z(CODE)BT_SDP_RXEXT=0x241800-0x241FFF

//-Z(CODE)TASK_TOMCAT_SEG=0x261800-0x261FFF
-Z(CODE)BT_RXAT_CMD,BT_RXAT_CMD_CONST=0x261800-0x261FFF

-Z(CODE)TASK_MUSIC_SEG_1=0x281800-0x281FFF

//-Z(CODE)LUNAR_ALGORITHM,LUNAR_ALGORITHM_CONST=0x291800-0x291FFF
-Z(CODE)BT_RFC_TX,BT_RFC_TX_CONST=0x291800-0x291FFF

//-Z(CODE)CHECK_BOX_SEG,CHECK_CONTENT=0x2A1800-0x2A1FFF
-Z(CODE)HCI_SEND_ACL,BT_AVCTP=0x2A1800-0x2A1FFF

//-Z(CODE)TASK_SHOW_TIME_SEG=0x2B1800-0x2B1FFF
-Z(CODE)BT_L2CAP_RCV_BANK,BT_SDP,BT_SDP_CONSTSEG,BT_SDP_RECORD=0x2B1800-0x2B1FFF


-Z(CODE)EQ_CONST,EQ_SEG,MP3_SEG,MP3_SEG_CONST=0x2C1800-0x2C1FFF
-Z(CODE)BT_HCI_EVENT=0x2D1800-0x2D1FFF

-Z(CODE)TASK_BT_SEG,TASK_BT_SEG_CONST=0x271800-0x271FFF
-Z(CODE)BT_API=0x2D1800-0x2D1FFF   //Note:BT_API_PARAM,BT_API_PARAM_NR两个段必须放在同一bank
-Z(CODE)BT_API_CMD,BT_API_CONST=0x2E1800-0x2E1FFF
-Z(CODE)BT_API2,BT_API_PARAM,BT_API_PARAM_NR=0x2F1800-0x2F1FFF
-Z(CODE)FAT_API_SEG_2=0x301800-0x301FFF
-Z(CODE)TFF_SEG=0x2F1800-0x2F1FFF
 -Z(CODE)TASK_RECORD_SEG_1,TASK_RECORD_1_CONST=0x311800-0x311FFF
/*****************************************************************************
 * Section   : 以下是随意分段，不关注切Bank的效率
 *****************************************************************************/

-P(CODE)FAT_SEG,FAT_API_SEG_1,MP3_SEG_1,\
DEV_INIT,USB_INIT,SD_INIT,GET_FILENAME=[_BANK_START-_BANK_END]*_BANK_NUM+_BANK_STEP

//Note: 一般不知道放哪里的，就放在这里
-P(CODE)LCD_INIT_SEG,FONT_SEG1,FILE_LIST_SEG_1,FILE_FILTER_SEG_1,FM_SEG_QN8065_1,FM_SEG_AX5111_1,FM_SEG_RTC6218_1,\
TASK_MENU_SEG_1,TASK_MUSIC_SEG_2,MUSIC_ID3_SEG_1,MUSIC_ID3_SEG_2,TASK_FM_SEG_1,DISP_LEDSEG_SEG_1,\
MSG_BOX_SEG,NUM_BOX_SEG,ALARM,DISPLAY_MEM,RTC_SEG,PASSWORD_SEG,INIT_SEG_1,TASK_CLOCK_SEG_1,TASK_EBOOK_SEG1,TASK_BT_SEG_1,BT_API_1,\
TASK_EBOOK_SEG2,DRAW_IMG_SEG1,FNAV_SEG_1,TASK_REPEATER_SEG_1,TASK_REPEATER_SEG_2,LRC_INIT,LRC_API,LIST_BOX_SEG1,TASK_SETTING_SEG_1\
=[_BANK_START-_BANK_END]*_BANK_NUM+_BANK_STEP

-P(CODE)BT_HCI,BT_HCI_ACL,BT_HCI_EVENT_DISC,BT_HCI_EVENT_DISC_1,BT_HCI_EVENT_LINK,BT_HCI_EVENT_CONN,BT_HCI_EVENT_CMD=[_BANK_START-_BANK_END]*_BANK_NUM+_BANK_STEP

-P(CODE)BT_L2CAP,BT_L2CAP_CREATE,BT_L2CAP_SIG=[_BANK_START-_BANK_END]*_BANK_NUM+_BANK_STEP

-P(CODE)BT_L2CAP_SIG_CONN,BT_L2CAP_CONN_IND,BT_L2CAP_CONN_CFM,BT_L2CAP_DISC_IND=[_BANK_START-_BANK_END]*_BANK_NUM+_BANK_STEP

-P(CODE)BT_L2CAP_HDL,BT_SDP_CFM,BT_L2CA_CONNRSP,BT_L2CAP_CONNRSP,BT_L2CAP_DEL,BT_L2CAP_FREE=[_BANK_START-_BANK_END]*_BANK_NUM+_BANK_STEP

-P(CODE)BT_L2CAP_CFGREQ,BT_L2CA_CFGRSP,BT_L2CAP_CFGRSP,BT_L2CAP_CFGRES=[_BANK_START-_BANK_END]*_BANK_NUM+_BANK_STEP
-P(CODE)BT_L2CAP_LCID,BT_L2CAP_DISCREQ,BT_L2CAP_DISCRES,BT_L2CAP_ECHO,BT_L2CAP_INFO=[_BANK_START-_BANK_END]*_BANK_NUM+_BANK_STEP
-P(CODE)BT_L2CAP_PROC=[_BANK_START-_BANK_END]*_BANK_NUM+_BANK_STEP
-P(CODE)TASK_SHOW_TIME_SEG=[_BANK_START-_BANK_END]*_BANK_NUM+_BANK_STEP
-P(CODE)TASK_CLOCK_SEG,TASK_CLOCK_CONST=[_BANK_START-_BANK_END]*_BANK_NUM+_BANK_STEP

-P(CODE)BT_API_SEG=[_BANK_START-_BANK_END]*_BANK_NUM+_BANK_STEP
-P(CODE)BT_SDP_CONN=[_BANK_START-_BANK_END]*_BANK_NUM+_BANK_STEP
-P(CODE)BT_HID_CONN,BT_HID=[_BANK_START-_BANK_END]*_BANK_NUM+_BANK_STEP
-P(CODE)BT_SDP_DISCREQ=[_BANK_START-_BANK_END]*_BANK_NUM+_BANK_STEP
-P(CODE)BT_SDP_SERRSP=[_BANK_START-_BANK_END]*_BANK_NUM+_BANK_STEP
-P(CODE)BT_SDP_ERRRSP,BT_SDP_ATTR=[_BANK_START-_BANK_END]*_BANK_NUM+_BANK_STEP
-P(CODE)BT_SDP_CHK=[_BANK_START-_BANK_END]*_BANK_NUM+_BANK_STEP
-P(CODE)BT_SDP_SHOW=[_BANK_START-_BANK_END]*_BANK_NUM+_BANK_STEP
-P(CODE)BT_SDP_SERREQ,BT_SDP_SERAREQ=[_BANK_START-_BANK_END]*_BANK_NUM+_BANK_STEP
-P(CODE)BT_RFC_SERCH=[_BANK_START-_BANK_END]*_BANK_NUM+_BANK_STEP

-P(CODE)BT_HSHF,BT_HSHF_API=[_BANK_START-_BANK_END]*_BANK_NUM+_BANK_STEP

-P(CODE)BT_AVCTP_RX=[_BANK_START-_BANK_END]*_BANK_NUM+_BANK_STEP

-P(CODE)BT_AVDTP,BT_AVDTP_SIGNAL,BT_AVDTP_NG=[_BANK_START-_BANK_END]*_BANK_NUM+_BANK_STEP

-P(CODE)BT_RFC,BT_RFC_STATE,BT_RFC_MCC,BT_RFC_SABM,BT_RFC_UA,BT_RFC_RXDM,BT_RFC_PDISC,BT_RFC_RXDISC,BT_RFC_UIH=[_BANK_START-_BANK_END]*_BANK_NUM+_BANK_STEP
-P(CODE)BT_RFC_CREDIT,BT_RFC_CFM=[_BANK_START-_BANK_END]*_BANK_NUM+_BANK_STEP

-P(CODE)BT_RFC_SEND,BT_RFC_SEND_CREDIT=[_BANK_START-_BANK_END]*_BANK_NUM+_BANK_STEP
-P(CODE)BT_RFC_CONN=[_BANK_START-_BANK_END]*_BANK_NUM+_BANK_STEP
-P(CODE)BT_AP_DISC,BT_AVDTP_MEDIA_CONN,BT_AVCTP_CONN,BT_AVDTP_CONN=[_BANK_START-_BANK_END]*_BANK_NUM+_BANK_STEP

-P(CODE)BT_AT_CMD2=[_BANK_START-_BANK_END]*_BANK_NUM+_BANK_STEP
-P(CODE)BT_ON_SEG,BT_ON_CONST=[_BANK_START-_BANK_END]*_BANK_NUM+_BANK_STEP

-P(CODE)BANKED_CODE,BT_AVDTP_MEDIA1=[_BANK_START-_BANK_END]*_BANK_NUM+_BANK_STEP

/*****************************************************************************
 * Section   : 公共区空间的分段
 *****************************************************************************/
-Z(CODE)DPATH_SEG,BT_UART_TX_SEG,USB_AUDIO_GET_PCM,L2CADATA_READ=_CODE_START-_CODE_END
-Z(CODE)DISP_LEDSEG_SCAN=_CODE_START-_CODE_END

/*****************************************************************************
 * Section   : 任务局部公共区空间
 *****************************************************************************/
-Z(CODE)MP3_EN_COM,FAT_COM_SEG,MP3_DEC_COM,MUSIC_COM,WAV_DEC_COM,WMA_DEC_COM=0x1200-0x17ff

-Z(CODE)BT_MODE_API=0x11200-0x117ff
-Z(CODE)BT_UART_ROUTE,PROCESS_RECEIVE,HCI_SEND_CMD,BT_HCI_RXACL,BT_L2CAP_RCV,BT_NAME=0x11200-0x117ff

/*****************************************************************************
 * Section   : DCODE空间的分段，请勿随意添加
 *****************************************************************************/
//6K供FM模块使用
-Z(CODE)TASK_FMPLAY_SEG,TASK_FMPLAY_DISP_SEG=0x844000-0x8457FF

//6K供蓝牙模块使用
-Z(CODE)BT_SCO_SEG,USB_SCO_RESAMPLE_ASM,SCO_PCM_OUT=0x864800-0x865FFF
-Z(CODE)BT_DEC_SEG=0x854800-0x855FFF

-Z(CODE)BT_DEC_INT_SEG,SBC_PCM_OUT,BT_AVDTP_MEDIA,BT_VOICE_SEG,BT_STATE_CHANGE=0x854800-0x855FFF
-Z(CODE)HCI_EVENT_DSEG,HCI_SEND_CMD_DSEG,HCI_TXCMD_HOSTNUM=0x854800-0x855FFF
-Z(CODE)USB_RESAMPLE_ASM,BT_RESAMPLE_CONST=0x854800-0x855FFF
-Z(CODE)BT_SHOWINFO_SEG,BT_SHOWINFO_CONST=0x854800-0x855FFF

//2K供文件系统目录搜索使用
-Z(CODE)FAT_DPATH_SEG=0x874000-0x8747FF

//临时区
-Z(CODE)SEARCH_AVDTP=0x854800-0x855FFF

-Z(CODE)MAKECODE_CONST=0xFF0000-0xFF0FFF

/*****************************************************************************
 * Section   : 以内存空间的分段
 *****************************************************************************/
-Z(XDATA)OCX_XDATA=_XDATA_START-_XDATA_END
-Z(XDATA)DIR_PATH_BUF=0x2C00-0x2DF8

//复用XDATA区0x0CD0~0x3CFF
-Z(XDATA)MUSIC_XDATA=0x103CD0-0x103CFF
-Z(XDATA)FM_XDATA,AX5111_XDATA,RECORD_XDATA=0x203CD0-0x203CFF
-Z(XDATA)AUX_XDATA=0x303CD0-0x303CFF
-Z(XDATA)USBDEV_XDATA=0x403CD0-0x403CFF
-Z(XDATA)CLOCK_XDATA,SPEAKER_XDATA=0x503CD0-0x503CFF
-Z(XDATA)BT_XDATA=0x603CD0-0x603CFF

//复用OBUF区0x8000~0x88FF
-Z(XDATA)DIR_PATH_XDATA,DIR_PATH_CACHE=0x8000-0x88FF
-Z(XDATA)FM_CH_BUF=0x208000-0x2088FF

//复用IRAM2,0x8900~0x9FFF
-Z(XDATA)MIX_BUF,MIX_XDATA=0x708900-0x709FFF
-Z(XDATA)MUSIC_ID3BUFF=0x109800

-Z(XDATA)ID3_BUFF=0x3808-0x39FF

// SBC decode's xdata and data
-Z(DATA)SBC_DATA=0x148-0x15A
-Z(DATA)USB_RESAMPLE_DATA=0x6C-0x77

-Z(XDATA)BT_SDP_XDATA=0x602A00-0x602BFF
-Z(XDATA)BT_SBC_XDATA=0x602C00-0x603A00
-Z(XDATA)SbcDec,SbcXdata=0x602389-0x6026FF
-Z(XDATA)BT_VOICE_IBUF=0x612389-0x6126FF
-Z(XDATA)SbcEvent=0x603100-0x6037FF

-Z(XDATA)BT_AVDTP_XDATA=0x606400-0x606FFF
-Z(XDATA)BT_SCOFAR_XDATA=0x616400-0x616FFF

-Z(XDATA)SbcPaired=0x608900-0x609DFF
-Z(XDATA)BTV_XDATA=0x608900-0x609DFF
-Z(XDATA)SCO_VAD_BUF,BTQ_XDATA,BT_HOSAPI_XDATA,BT_A2DP_XDATA,BT_HSHF_XDATA,BT_L2CAP_OCT_XDATA=0x608900-0x609DFF
-Z(XDATA)BT_RFC_XDATA,BT_ATCMD_XDATA,BTAPI_XDATA,USB_RESAMPLE_XDATA=0x608900-0x609DFF
-Z(XDATA)BT_L2CAP_XDATA,BT_HCI_XDATA,BT_MSG_POOL,FIR_COFF,FIR_BUFF,SPP_XDATA=0x608900-0x609DFF
-Z(XDATA)BT_UART_RXBUF=0x609E00-0x609EFF
-Z(XDATA)BT_UART_TXBUF=0x609F00-0x609FFF

//OTP最后16Byte保留
-Z(CODE)PROGRAM_CODE=0x7FF0-0x7FFF
